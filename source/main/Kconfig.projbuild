## source/main/Kconfig.projbuild
```kconfig
menu "Soil Sensor Configuration"

    config SOIL_SAMPLE_INTERVAL_SECONDS
        int "Soil sample interval (seconds)"
        default 1800
        range 60 86400
        help
            How often the firmware wakes to sample the soil probe and battery.
            Sampling is local (no radio); the reading is only reported over
            Thread when it changes by at least the report delta.

    config SOIL_REPORT_DELTA_PERCENT
        int "Report delta (percent)"
        default 2
        range 1 20
        help
            Minimum change in soil moisture percent before the Matter
            attribute is updated (and therefore reported to subscribers).

    config SOIL_EXCITATION_SETTLE_MS
        int "Probe excitation settle time (ms)"
        default 300
        range 10 5000
        help
            Delay between enabling the 200 kHz excitation PWM and the first
            ADC read, letting the probe's RC filter settle.

    config SOIL_CAL_MAX_SPREAD_MV
        int "Maximum allowed calibration spread (mV)"
        default 60
        range 10 500
        help
            Maximum spread (trimmed max minus trimmed min) allowed during
            dry or wet calibration. Readings noisier than this are rejected
            so unstable probes do not overwrite NVS calibration.

    config SOIL_CAL_DEFAULT_DRY_MV
        int "Default dry calibration (mV)"
        default 2750
        help
            Probe output in millivolts in dry air. Overridden by button
            calibration (triple press), which persists to NVS.

    config SOIL_CAL_DEFAULT_WET_MV
        int "Default wet calibration (mV)"
        default 1200
        help
            Probe output in millivolts in water. Overridden by button
            calibration (triple press), which persists to NVS.

    choice SOIL_BATTERY_CHEMISTRY
        prompt "Battery chemistry profile"
        default SOIL_BATTERY_CHEMISTRY_ALKALINE
        help
            Select the voltage-to-percent curve used for battery telemetry.
            Alkaline, NiMH, and Lithium (Li-FeS2) use piecewise curves fitted
            to their discharge profiles; Linear maps EMPTY_MV to FULL_MV.

        config SOIL_BATTERY_CHEMISTRY_ALKALINE
            bool "Alkaline AA (piecewise curve)"

        config SOIL_BATTERY_CHEMISTRY_NIMH
            bool "NiMH rechargeable AA (1.2 V)"

        config SOIL_BATTERY_CHEMISTRY_LITHIUM
            bool "Lithium primary AA (Li-FeS2)"

        config SOIL_BATTERY_CHEMISTRY_LINEAR
            bool "Linear (EMPTY_MV to FULL_MV)"
    endchoice

    config SOIL_BATTERY_EMPTY_MV
        int "Battery empty voltage at ADC pin (mV)"
        default 1000
        help
            ADC pin voltage that maps to 0% battery. Used only when
            SOIL_BATTERY_CHEMISTRY_LINEAR is selected.

    config SOIL_BATTERY_FULL_MV
        int "Battery full voltage at ADC pin (mV)"
        default 1500
        help
            ADC pin voltage that maps to 100% battery. Used only when
            SOIL_BATTERY_CHEMISTRY_LINEAR is selected.

    config SOIL_CPU_DFS_IDLE
        bool "Allow CPU frequency scaling down to XTAL when idle"
        default y
        help
            When enabled, esp_pm scales the CPU clock down to CONFIG_XTAL_FREQ
            (40 MHz on ESP32-C6) whenever no PM lock is held. Disable to pin
            the CPU clock at the default frequency.

    config SOIL_BATTERY_SAG_WARN_MV
        int "Battery sag warning threshold (mV)"
        default 60
        help
            Sag between resting and LED-loaded readings that reports charge
            level Warning and sets BatReplacementNeeded. Healthy alkalines
            sag under ~20 mV; worn cells far more.

    config SOIL_BATTERY_SAG_CRIT_MV
        int "Battery sag critical threshold (mV)"
        default 150
        help
            Sag at which charge level reports Critical.

    config SOIL_THREAD_TX_POWER_DBM
        int "Thread radio TX power (dBm)"
        default 10
        range -24 20
        help
            802.15.4 transmit power. The driver default is +20 dBm
            (~350 mA TX peaks); +10 dBm cuts peak battery draw roughly 3x
            with range to spare for a home Thread mesh.

endmenu
```
